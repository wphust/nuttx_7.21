## nuttx-7.21/nx/apps/examples/myapp/Kconfig
```kconfig
#
# For a description of the syntax of this configuration file,
# see the file kconfig-language.txt in the NuttX tools repository.
#

config EXAMPLES_MyAPP
	bool "My First Application"
	default n
	---help---
		Enable the \"myapp\" example 

if EXAMPLES_MyAPP

config EXAMPLES_MYAPP_PROGNAME
	string "Program name"
	default "myapp"
	depends on BUILD_KERNEL
	---help---
		This is the name of the program that will be use when the NSH ELF
		program is installed.

config EXAMPLES_MYAPP_PRIORITY
	int "MyAPP task priority"
	default 100

config EXAMPLES_MYAPP_STACKSIZE
	int "MyAPP stack size"
	default 2048

endif
```

## nuttx-7.21/nx/apps/g3/example/Kconfig
```kconfig
#
# For a description of the syntax of this configuration file,
# see the file kconfig-language.txt in the NuttX tools repository.
#

config G3_EXAMPLE
	bool "G3 example"
	default n
	---help---
		Enable the G3 example

if G3_EXAMPLE

config G3_EXAMPLE_PROGNAME
	string "Program name"
	default "example"
	depends on BUILD_KERNEL
	---help---
		This is the name of the program that will be use when the NSH ELF
		program is installed.

config G3_EXAMPLE_PRIORITY
	int "G3 example task priority"
	default 100

config G3_EXAMPLE_STACKSIZE
	int "G3 example stack size"
	default 2048

endif
```

## nuttx-7.21/nx/apps/g3/mcreceiver/Kconfig
```kconfig
#
# For a description of the syntax of this configuration file,
# see the file kconfig-language.txt in the NuttX tools repository.
#

config G3_MCRECEIVER
	bool "G3 mcreceiver"
	default n
	---help---
		Enable the G3 mcreceiver

if G3_MCRECEIVER

config G3_MCRECEIVER_PROGNAME
	string "Program name"
	default "mcreceiver"
	depends on BUILD_KERNEL
	---help---
		This is the name of the program that will be use when the NSH ELF
		program is installed.

config G3_MCRECEIVER_PRIORITY
	int "G3 mcreceiver task priority"
	default 100

config G3_MCRECEIVER_STACKSIZE
	int "G3 mcreceiver stack size"
	default 2048

endif
```

## nuttx-7.21/nx/apps/g3/mcsender/Kconfig
```kconfig
#
# For a description of the syntax of this configuration file,
# see the file kconfig-language.txt in the NuttX tools repository.
#

config G3_MCSENDER
	bool "G3 mcsender"
	default n
	---help---
		Enable the G3 mcsender

if G3_MCSENDER

config G3_MCSENDER_PROGNAME
	string "Program name"
	default "mcsender"
	depends on BUILD_KERNEL
	---help---
		This is the name of the program that will be use when the NSH ELF
		program is installed.

config G3_MCSENDER_PRIORITY
	int "G3 mcsender task priority"
	default 100

config G3_MCSENDER_STACKSIZE
	int "G3 mcsender stack size"
	default 2048

endif
```
